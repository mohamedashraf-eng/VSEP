## linux/yocto/poky_dunfell/build/conf/bblayers.conf
```bitbake
# POKY_BBLAYERS_CONF_VERSION is increased each time build/conf/bblayers.conf
# changes incompatibly
POKY_BBLAYERS_CONF_VERSION = "2"

BBPATH = "${TOPDIR}"
BBFILES ?= ""

BBLAYERS ?= " \
    /home/wx/Documents/WX_COTS/LINUX_COTS/YOCTO/rpi/poky_dunfell/meta \
    /home/wx/Documents/WX_COTS/LINUX_COTS/YOCTO/rpi/poky_dunfell/meta-poky \
    /home/wx/Documents/WX_COTS/LINUX_COTS/YOCTO/rpi/poky_dunfell/meta-yocto-bsp \
    /home/wx/Documents/WX_COTS/LINUX_COTS/YOCTO/rpi/poky_dunfell/meta-openembedded/meta-oe \
    /home/wx/Documents/WX_COTS/LINUX_COTS/YOCTO/rpi/poky_dunfell/meta-openembedded/meta-multimedia \
    /home/wx/Documents/WX_COTS/LINUX_COTS/YOCTO/rpi/poky_dunfell/meta-openembedded/meta-networking \
    /home/wx/Documents/WX_COTS/LINUX_COTS/YOCTO/rpi/poky_dunfell/meta-openembedded/meta-python \  
    /home/wx/Documents/WX_COTS/LINUX_COTS/YOCTO/rpi/poky_dunfell/meta-raspberrypi \
    "
```
